## Zephyr_apps/blinky/boards/vmsboards/vms_module_rev1/board.yml
```yaml
board:
  name: vms_module_rev1
  vendor: vmsboards
  socs:
    - name: stm32c092xx
```

## Zephyr_apps/blinky/build/Kconfig/Kconfig.shield.defconfig
```kconfig
osource "C:/Users/casey/github/2027-SAE-Electric-VCU/Zephyr_apps/blinky/../boards/shields/*/Kconfig.defconfig"
```

## Zephyr_apps/blinky/build/Kconfig/boards/Kconfig.defconfig
```kconfig
# Load Zephyr board defconfig descriptions.
osource "C:/Users/casey/github/2027-SAE-Electric-VCU/Zephyr_apps/boards/vmsboards/vms_module_rev1/Kconfig.defconfig"
```

## Zephyr_apps/blinky/build/Kconfig/boards/Kconfig.vms_module_rev1
```kconfig
# Load board Kconfig descriptions.
osource "C:/Users/casey/github/2027-SAE-Electric-VCU/Zephyr_apps/boards/vmsboards/vms_module_rev1/Kconfig.vms_module_rev1"
```

## Zephyr_apps/boards/vmsboards/vms_module_rev1/board.yml
```yaml
board:
  name: vms_module_rev1
  full_name: VMS Module Rev1
  vendor: vmsboards
  socs:
    - name: stm32c092xx
```
