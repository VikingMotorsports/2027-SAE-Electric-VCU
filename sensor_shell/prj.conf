## CMakeLists.txt
```
# SPDX-License-Identifier: Apache-2.0

cmake_minimum_required(VERSION 3.20.0)

find_package(Zephyr REQUIRED HINTS $ENV{ZEPHYR_BASE})
project(sensor_shell)

target_sources(app PRIVATE src/main.c)

target_sources_ifdef(CONFIG_SAMPLES_SENSOR_SHELL_FAKE_SENSOR app PRIVATE
  src/fake_sensor.c
)

target_include_directories(app PRIVATE include)
```

## Kconfig
```
# Copyright (c) 2023 Google LLC
# SPDX-License-Identifier: Apache-2.0

config SAMPLES_SENSOR_SHELL_FAKE_SENSOR
	bool "Enable fake sensor"
	default y
	depends on DT_HAS_VND_FAKE_SENSOR_ENABLED
	help
	  On boards that do not have a sensor, enabling this will build a fake
	  sensor that can be interacted with via the sensor shell.

source "Kconfig.zephyr"
```

## sample.yaml
```
sample:
  name: Shell Sensor Module Sample
common:
  tags:
    - sensor
    - shell

tests:
  sample.sensor.shell:
    integration_platforms:
      - frdm_k64f
    # TODO Remove once #63414 is resolved
    platform_exclude: gd32l233r_eval
    filter: ( CONFIG_UART_CONSOLE and CONFIG_SERIAL_SUPPORT_INTERRUPT )
    harness: keyboard
    min_ram: 20
    min_flash: 33
  sample.sensor.shell.pytest:
    platform_exclude: qemu_rx
    filter: CONFIG_SERIAL and dt_chosen_enabled("zephyr,shell-uart")
    min_ram: 40
    harness: pytest
    timeout: 180
    extra_configs:
      - arch:posix:CONFIG_UART_NATIVE_PTY_0_ON_STDINOUT=y
      - platform:iotdk/arc_iot:CONFIG_ARC_IOT_CUSTOM_CPU_IDLE=y
    extra_args: DTC_OVERLAY_FILE=fake_sensor.overlay
    integration_platforms:
      - native_sim
  sample.sensor.shell.shields:
    platform_allow:
      - adafruit_qt_py_rp2040/rp2040
    extra_args:
      - platform:adafruit_qt_py_rp2040/rp2040:SHIELD="adafruit_ina237"
```

## prj.conf
```kconfig
CONFIG_SHELL=y
CONFIG_BOOT_BANNER=n
CONFIG_SENSOR=y
CONFIG_SENSOR_SHELL=y
CONFIG_SENSOR_INFO=y

CONFIG_LOG=y
CONFIG_RTIO_CONSUME_SEM=y

CONFIG_MAIN_STACK_SIZE=2048
```

## boards/mimxrt1040_evk.conf
```kconfig
CONFIG_FXLS8974_TRIGGER_OWN_THREAD=n
CONFIG_FXLS8974_TRIGGER_NONE=y
```

## boards/mimxrt1062_fmurt6.conf
```kconfig
CONFIG_BMP388_TRIGGER_NONE=y
```

## boards/robokit1.conf
```kconfig
# Copyright (c) 2023 Google LLC
# SPDX-License-Identifier: Apache-2.0
CONFIG_SPI_RTIO=y
```

## boards/vmu_rt1170_mimxrt1176_cm7.conf
```kconfig
# Copyright 2025 CogniPilot Foundation
# SPDX-License-Identifier: Apache-2.0

CONFIG_DEBUG=y
CONFIG_SENSOR_SHELL_STREAM=y
CONFIG_SENSOR_LOG_LEVEL_DBG=n
CONFIG_RTIO_SUBMIT_SEM=y
CONFIG_SPI_RTIO=y
CONFIG_SPI_ASYNC=y
CONFIG_SYS_CLOCK_TICKS_PER_SEC=10000
```

## fake_sensor.overlay
```dts
/*
 * Copyright (c) 2024 Meta Platforms
 *
 * SPDX-License-Identifier: Apache-2.0
 */

/ {
	app {
		#address-cells = <1>;
		#size-cells = <0>;

		vsensor0: sensor@0 {
			compatible = "vnd,fake-sensor";
			reg = <0>;
			friendly-name = "Fake sensor 0";
			status = "okay";
		};

		vsensor1: sensor@1 {
			compatible = "vnd,fake-sensor";
			reg = <1>;
			friendly-name = "Fake sensor 1";
			status = "okay";
		};
	};
};
```

## dts/bindings/vnd,fake-sensor.yaml
```yaml
# Copyright (c) 2024 Meta Platforms
# SPDX-License-Identifier: Apache-2.0

description: Fake sensor

include: sensor-device.yaml

compatible: "vnd,fake-sensor"
```

## src/main.c
```c
/*
 * Copyright (c) 2018 Diego Sueiro
 *
 * SPDX-License-Identifier: Apache-2.0
 */

/*
 * This sample app launches a shell. Interact with it using the `sensor` command. See
 * `drivers/sensor/sensor_shell.c`. There is nothing to do in the main thread.
 */

int main(void)
{
	return 0;
}
```

## include/trigger.h
```c
/*
 * Copyright (c) 2023 Google LLC
 *
 * SPDX-License-Identifier: Apache-2.0
 */

#ifndef ZEPHYR_SAMPLES_SENSOR_SENSOR_SHELL_INCLUDE_TRIGGER_H
#define ZEPHYR_SAMPLES_SENSOR_SENSOR_SHELL_INCLUDE_TRIGGER_H

#include <zephyr/device.h>
#include <zephyr/drivers/sensor.h>

void sensor_shell_data_ready_trigger_handler(const struct device *sensor,
					     const struct sensor_trigger *trigger);

#endif /* ZEPHYR_SAMPLES_SENSOR_SENSOR_SHELL_INCLUDE_TRIGGER_H */
```

## src/fake_sensor.c
```c
/*
 * Copyright (c) 2024 Meta Platforms
 *
 * SPDX-License-Identifier: Apache-2.0
 */

#define DT_DRV_COMPAT vnd_fake_sensor

#include <zephyr/device.h>
#include <zephyr/drivers/sensor.h>
#include <zephyr/logging/log.h>

LOG_MODULE_REGISTER(fake_sensor);

static int init(const struct device *dev)
{
	ARG_UNUSED(dev);

	return 0;
}

static int attr_set(const struct device *dev, enum sensor_channel chan, enum sensor_attribute attr,
		    const struct sensor_value *val)
{
	LOG_DBG("[%s] dev: %p, chan: %d, attr: %d, val1: %d, val2: %d", __func__, dev, chan, attr,
		val->val1, val->val2);

	return 0;
}

static int attr_get(const struct device *dev, enum sensor_channel chan, enum sensor_attribute attr,
		    struct sensor_value *val)
{
	LOG_DBG("[%s] dev: %p, chan: %d, attr: %d", __func__, dev, chan, attr);

	val->val1 = chan;
	val->val2 = attr * 100000;

	return 0;
}

static int sample_fetch(const struct device *dev, enum sensor_channel chan)
{
	LOG_DBG("[%s] dev: %p, chan: %d", __func__, dev, chan);

	return 0;
}

static int channel_get(const struct device *dev, enum sensor_channel chan, struct sensor_value *val)
{
	LOG_DBG("[%s] dev: %p, chan: %d", __func__, dev, chan);

	switch (chan) {
	case SENSOR_CHAN_ACCEL_XYZ:
		__fallthrough;
	case SENSOR_CHAN_GYRO_XYZ:
		__fallthrough;
	case SENSOR_CHAN_MAGN_XYZ:
		__fallthrough;
	case SENSOR_CHAN_POS_DXYZ:
		for (int i = 0; i < 3; i++, val++) {
			val->val1 = chan;
			val->val2 = 1;
		}
		break;
	default:
		val->val1 = chan;
		val->val2 = 1;
		break;
	}

	return 0;
}

static int trigger_set(const struct device *dev, const struct sensor_trigger *trig,
		       sensor_trigger_handler_t handler)
{
	LOG_DBG("[%s - %s] dev: %p, trig->chan: %d, trig->type: %d, handler: %p", __func__,
		(handler == NULL) ? "off" : "on", dev, trig->chan, trig->type, handler);

	return 0;
}

static DEVICE_API(sensor, api) = {
	.attr_get = attr_get,
	.attr_set = attr_set,
	.sample_fetch = sample_fetch,
	.channel_get = channel_get,
	.trigger_set = trigger_set,
};

#define VND_SENSOR_INIT(n)                                                                         \
	SENSOR_DEVICE_DT_INST_DEFINE(n, init, NULL, NULL, NULL, POST_KERNEL,                       \
				     CONFIG_SENSOR_INIT_PRIORITY, &api);

DT_INST_FOREACH_STATUS_OKAY(VND_SENSOR_INIT)
```
